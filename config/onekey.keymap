/*
 * Copyright (c) 2022-2023 The ZMK Contributors
 *
 * SPDX-License-Identifier: MIT
 */
 
#include <behaviors.dtsi>
#include <dt-bindings/zmk/keys.h>
#include <dt-bindings/zmk/outputs.h>
#include <dt-bindings/zmk/bt.h>

/ {

    keymap {
        compatible = "zmk,keymap";

        qw_layer {
            bindings = < &kp A    >;
        };

    };
};
